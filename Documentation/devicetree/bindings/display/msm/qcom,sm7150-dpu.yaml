## Documentation/devicetree/bindings/input/awinic,aw8695-haptics.yaml
```yaml
# SPDX-License-Identifier: (GPL-2.0-only OR BSD-2-Clause)
%YAML 1.2
---
$id: http://devicetree.org/schemas/input/awinic,aw8695-haptics.yaml#
$schema: http://devicetree.org/meta-schemas/core.yaml#

title: Awinic AW8695 LRA Haptic Driver

maintainers:
  - Luca Weiss <luca.weiss@fairphone.com>

properties:
  compatible:
    const: awinic,aw8695

  reg:
    maxItems: 1

  interrupts:
    maxItems: 1
    description: GPIO connected to INTN pin (edge falling)

  reset-gpios:
    maxItems: 1
    description: GPIO connected to RSTN pin (active high)

  awinic,f0-preset:
    $ref: /schemas/types.yaml#/definitions/uint32
    description: Default value for the f0 of LRA

  awinic,f0-coefficient:
    $ref: /schemas/types.yaml#/definitions/uint32
    description: Coefficient between actual f0 and the value in the registers

  awinic,f0-calibration-percent:
    maxItems: 1
    description: Limit of f0 deviation from awinic,f0-preset

  awinic,drive-level:
    $ref: /schemas/types.yaml#/definitions/uint32
    description: Level of drive waveform in normal driving

  awinic,f0-detection-play-time:
    $ref: /schemas/types.yaml#/definitions/uint32
    description: Drive waveform play times in the first period in the f0 detection

  awinic,f0-detection-wait-time:
    $ref: /schemas/types.yaml#/definitions/uint32
    description: Waveform wait times in the f0 detection

  awinic,f0-detection-repeat:
    $ref: /schemas/types.yaml#/definitions/uint32
    description: Repeat times in the f0 detection

  awinic,f0-detection-trace:
    $ref: /schemas/types.yaml#/definitions/uint32
    description: Drive waveform play times in the second period and later in the f0 detection

  awinic,boost-debug:
    $ref: /schemas/types.yaml#/definitions/uint8-array
    minItems: 3
    maxItems: 3
    description: Values for BSTDBG1-3 registers

  awinic,tset:
    $ref: /schemas/types.yaml#/definitions/uint8
    description: Value for TSET register

  awinic,r-spare:
    $ref: /schemas/types.yaml#/definitions/uint8
    description: Value for R_SPARE register

  awinic,bemf-upper-threshold:
    $ref: /schemas/types.yaml#/definitions/uint32
    description: Back EMF (electromotive force) upper threshold

  awinic,bemf-lower-threshold:
    $ref: /schemas/types.yaml#/definitions/uint32
    description: Back EMF (electromotive force) lower threshold

required:
  - compatible
  - reg
  - interrupts
  - reset-gpios
  - awinic,f0-preset
  - awinic,f0-coefficient
  - awinic,f0-calibration-percent
  - awinic,drive-level
  - awinic,f0-detection-play-time
  - awinic,f0-detection-wait-time
  - awinic,f0-detection-repeat
  - awinic,f0-detection-trace
  - awinic,boost-debug
  - awinic,tset
  - awinic,r-spare
  - awinic,bemf-upper-threshold
  - awinic,bemf-lower-threshold

additionalProperties: false

examples:
  - |
    #include <dt-bindings/gpio/gpio.h>
    #include <dt-bindings/interrupt-controller/irq.h>
    i2c {
        #address-cells = <1>;
        #size-cells = <0>;

        haptics@5a {
            compatible = "awinic,aw8695";
            reg = <0x5a>;
            interrupts-extended = <&tlmm 85 IRQ_TYPE_EDGE_FALLING>;
            reset-gpios = <&tlmm 90 GPIO_ACTIVE_HIGH>;

            awinic,f0-preset = <2350>;
            awinic,f0-coefficient = <260>;
            awinic,f0-calibration-percent = <7>;
            awinic,drive-level = <125>;

            awinic,f0-detection-play-time = <5>;
            awinic,f0-detection-wait-time = <3>;
            awinic,f0-detection-repeat = <2>;
            awinic,f0-detection-trace = <15>;

            awinic,boost-debug = /bits/ 8 <0x30 0xeb 0xd4>;
            awinic,tset = /bits/ 8 <0x12>;
            awinic,r-spare = /bits/ 8 <0x68>;

            awinic,bemf-upper-threshold = <4104>;
            awinic,bemf-lower-threshold = <1016>;
        };
    };
```

## Documentation/devicetree/bindings/input/touchscreen/goodix,gt9886.yaml
```yaml
# SPDX-License-Identifier: GPL-2.0-only OR BSD-2-Clause
%YAML 1.2
---
$id: http://devicetree.org/schemas/input/touchscreen/goodix,gt9886.yaml#
$schema: http://devicetree.org/meta-schemas/core.yaml#

title: Goodix GTX8 series touchscreen controller

maintainers:
  - Jens Reidel <adrian@mainlining.org>

allOf:
  - $ref: touchscreen.yaml#

properties:
  compatible:
    enum:
      - goodix,gt9886
      - goodix,gt9896

  reg:
    maxItems: 1

  interrupts:
    maxItems: 1

  reset-gpios:
    maxItems: 1

  avdd-supply:
    description: Analog power supply regulator on AVDD pin

  vddio-supply:
    description: power supply regulator on VDDIO pin

  touchscreen-inverted-x: true
  touchscreen-inverted-y: true
  touchscreen-size-x: true
  touchscreen-size-y: true
  touchscreen-swapped-x-y: true

additionalProperties: false

required:
  - compatible
  - reg
  - interrupts
  - avdd-supply
  - touchscreen-size-x
  - touchscreen-size-y

examples:
  - |
    #include <dt-bindings/interrupt-controller/irq.h>
    #include <dt-bindings/gpio/gpio.h>
    i2c {
      #address-cells = <1>;
      #size-cells = <0>;
      touchscreen@5d {
        compatible = "goodix,gt9886";
        reg = <0x5d>;
        interrupt-parent = <&gpio>;
        interrupts = <9 IRQ_TYPE_LEVEL_LOW>;
        reset-gpios = <&gpio1 8 GPIO_ACTIVE_LOW>;
        avdd-supply = <&ts_avdd>;
        touchscreen-size-x = <1080>;
        touchscreen-size-y = <2340>;
      };
    };

...
```

## Documentation/devicetree/bindings/pinctrl/qcom,sm7150-pinctrl.txt
```
Qualcomm Technologies, Inc. SM7150 TLMM block

This binding describes the Top Level Mode Multiplexer block found in the
SM7150 platform.

- compatible:
	Usage: required
	Value type: <string>
	Definition: must be "qcom,sm7150-pinctrl"

- reg:
	Usage: required
	Value type: <prop-encoded-array>
	Definition: the base address and size of the north, south and west
		    TLMM tiles

- reg-names:
	Usage: required
	Value type: <prop-encoded-array>
	Definition: names for the cells of reg, must contain "north", "south"
		    and "west".

- interrupts:
	Usage: required
	Value type: <prop-encoded-array>
	Definition: should specify the TLMM summary IRQ.

- interrupt-controller:
	Usage: required
	Value type: <none>
	Definition: identifies this node as an interrupt controller

- #interrupt-cells:
	Usage: required
	Value type: <u32>
	Definition: must be 2. Specifying the pin number and flags, as defined
		    in <dt-bindings/interrupt-controller/irq.h>

- gpio-controller:
	Usage: required
	Value type: <none>
	Definition: identifies this node as a gpio controller

- #gpio-cells:
	Usage: required
	Value type: <u32>
	Definition: must be 2. Specifying the pin number and flags, as defined
		    in <dt-bindings/gpio/gpio.h>

- gpio-ranges:
	Usage: required
	Value type: <prop-encoded-array>
	Definition:  see ../gpio/gpio.txt

- gpio-reserved-ranges:
	Usage: optional
	Value type: <prop-encoded-array>
	Definition: see ../gpio/gpio.txt

Please refer to ../gpio/gpio.txt and ../interrupt-controller/interrupts.txt for
a general description of GPIO and interrupt bindings.

Please refer to pinctrl-bindings.txt in this directory for details of the
common pinctrl bindings used by client devices, including the meaning of the
phrase "pin configuration node".

The pin configuration nodes act as a container for an arbitrary number of
subnodes. Each of these subnodes represents some desired configuration for a
pin, a group, or a list of pins or groups. This configuration can include the
mux function to select on those pin(s)/group(s), and various pin configuration
parameters, such as pull-up, drive strength, etc.


PIN CONFIGURATION NODES:

The name of each subnode is not important; all subnodes should be enumerated
and processed purely based on their content.

Each subnode only affects those parameters that are explicitly listed. In
other words, a subnode that lists a mux function but no pin configuration
parameters implies no information about any pin configuration parameters.
Similarly, a pin subnode that describes a pullup parameter implies no
information about e.g. the mux function.


The following generic properties as defined in pinctrl-bindings.txt are valid
to specify in a pin configuration subnode:

- pins:
	Usage: required
	Value type: <string-array>
	Definition: List of gpio pins affected by the properties specified in
		    this subnode.

		    Valid pins are:
		      gpio0-gpio118
		        Supports mux, bias and drive-strength

		      sdc1_clk, sdc1_cmd, sdc1_data sdc2_clk, sdc2_cmd,
		      sdc2_data sdc1_rclk
		        Supports bias and drive-strength

		      ufs_reset
			Supports bias and drive-strength

- function:
	Usage: required
	Value type: <string>
	Definition: Specify the alternative function to be configured for the
		    specified pins. Functions are only valid for gpio pins.
		    Valid values are:

		    adsp_ext, agera_pll, aoss_cti, atest_char, atest_char0,
		    atest_char1, atest_char2, atest_char3, atest_tsens,
		    atest_tsens2, atest_usb1, atest_usb10, atest_usb11,
		    atest_usb12, atest_usb13, atest_usb2, atest_usb20,
		    atest_usb21, atest_usb22, atest_usb23, cam_mclk, cci_async,
		    cci_i2c, cci_timer0, cci_timer1, cci_timer2, cci_timer3,
		    cci_timer4, dbg_out, ddr_bist, ddr_pxi0, ddr_pxi1, ddr_pxi2,
		    ddr_pxi3, edp_hot, edp_lcd, gcc_gp1, gcc_gp2, gcc_gp3,
		    gp_pdm0, gp_pdm1, gp_pdm2, gpio, gps_tx, jitter_bist,
		    ldo_en, ldo_update, m_voc, mdp_vsync, mdp_vsync0,
		    mdp_vsync1, mdp_vsync2, mdp_vsync3, mss_lte, nav_pps_in,
		    nav_pps_out, pa_indicator, pci_e, phase_flag, pll_bist,
		    pll_bypassnl, pll_reset, pri_mi2s, pri_mi2s_ws, prng_rosc,
		    qdss_cti, qdss, qlink_enable, qlink_request, qua_mi2s,
		    qup00, qup02, qup03, qup04, qup10, qup11, qup12, qup13,
		    qup14, qup15, sd_write, sdc40, sdc41, sdc42, sdc43,
		    sdc4_clk, sdc4_cmd, sec_mi2s, ter_mi2s, tgu_ch0, tgu_ch1,
		    tgu_ch2, tgu_ch3, tsif1_clk, tsif1_data, tsif1_en,
		    tsif1_error, tsif1_sync, tsif2_clk, tsif2_data, tsif2_en,
		    tsif2_error, tsif2_sync, uim1_clk, uim1_data, uim1_present,
		    uim1_reset, uim2_clk, uim2_data, uim2_present, uim2_reset,
		    uim_batt, usb_phy, vfr_1, vsense_trigger, wlan1_adc0,
		    wlan1_adc1, wlan2_adc0, wlan2_adc1, wsa_clk, wsa_data,

- bias-disable:
	Usage: optional
	Value type: <none>
	Definition: The specified pins should be configured as no pull.

- bias-pull-down:
	Usage: optional
	Value type: <none>
	Definition: The specified pins should be configured as pull down.

- bias-pull-up:
	Usage: optional
	Value type: <none>
	Definition: The specified pins should be configured as pull up.

- output-high:
	Usage: optional
	Value type: <none>
	Definition: The specified pins are configured in output mode, driven
		    high.
		    Not valid for sdc pins.

- output-low:
	Usage: optional
	Value type: <none>
	Definition: The specified pins are configured in output mode, driven
		    low.
		    Not valid for sdc pins.

- drive-strength:
	Usage: optional
	Value type: <u32>
	Definition: Selects the drive strength for the specified pins, in mA.
		    Valid values are: 2, 4, 6, 8, 10, 12, 14 and 16

Example:

	tlmm: pinctrl@3500000 {
		compatible = "qcom,sm7150-pinctrl";
		reg = <0x0 0x03400000 0x0 0x300000>;
		reg-names = "west", "north", "south";
		interrupts = <GIC_SPI 208 IRQ_TYPE_LEVEL_HIGH>;
		gpio-controller;
		#gpio-cells = <2>;
		gpio-ranges = <&tlmm 0 0 119>;
		gpio-reserved-ranges = <0 4>, <106 4>;
		interrupt-controller;
		#interrupt-cells = <2>;
	};
```

## drivers/input/touchscreen/fts521/Kconfig
```kconfig
config TOUCHSCREEN_ST_FTS_V521
	tristate "STMicroelectronics FTS V521 touchscreen"
	depends on I2C
	depends on OF
	default n
	help
	  Say Y here if you have STMicroelectronics FingerTipS series touchscreen.

	  If unsure, say N.
	  
	  To compile this driver as a module, choose M here: the
	  module will be called fts521.
```

## drivers/input/touchscreen/gtx8/Kconfig
```kconfig
#
# Goodix touchscreen driver configuration
#
menuconfig TOUCHSCREEN_GOODIX_GTX8
	tristate "Goodix GTx8 touchscreen"
	depends on I2C
	depends on OF
	default n
	help
	  Say Y here if you have a Goodix GTx8 touch controller
	  to your system.

	  If unsure, say N.
```

## drivers/input/touchscreen/nt36672c/Kconfig
```kconfig
#
# Novatek NT36672C touchscreen driver configuration
#
config TOUCHSCREEN_NT36672C_HOSTDL_SPI
	tristate "Novatek NT36672C host download SPI driver"
	depends on SPI
	default y
	help
	  Say Y here if you have a Novatek NT36672C no flash touchscreen connected
	  to your system by SPI bus.

	  If unsure, say N.
```
